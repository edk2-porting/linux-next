// SPDX-License-Identifier: BSD-3-Clause
/*
 * Copyright (c) 2024, Xilin Wu <wuxilin123@gmail.com>
 * Copyright (c) 2024, Flao <placeholder@mail.com>
 * Copyright (c) 2024, Junhao Xie <bigfoot@classfun.cn>
 */

/dts-v1/;

#include "qcs8550-ayn-odin2.dtsi"

/ {
	model = "AYN Odin 2";
	compatible = "ayn,odin2", "qcom,qcs8550", "qcom,sm8550";
};
