// SPDX-License-Identifier: BSD-3-Clause
/*
 * Copyright (c) 2024, Xilin Wu <wuxilin123@gmail.com>
 */

/dts-v1/;

#include "qcs8550-ayn-odin2.dtsi"

/ {
	model = "AYN Odin 2 Mini";
	compatible = "ayn,odin2-mini", "qcom,qcs8550", "qcom,sm8550";
};
