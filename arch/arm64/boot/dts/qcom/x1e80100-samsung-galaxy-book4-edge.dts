// SPDX-License-Identifier: BSD-3-Clause
/*
 * Copyright (c) 2023 Qualcomm Innovation Center, Inc. All rights reserved.
 */

/dts-v1/;

#include "x1e80100-samsung-galaxy-book4-edge-common.dtsi"

/ {
	model = "Samsung Galaxy Book4 Edge";
};

&dispcc {
	status = "disabled";
};

&mdss {
	status = "okay";
};

