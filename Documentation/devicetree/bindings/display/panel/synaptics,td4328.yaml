## Documentation/devicetree/bindings/display/panel/synaptics,td4328.yaml
```yaml
# SPDX-License-Identifier: GPL-2.0-only OR BSD-2-Clause
%YAML 1.2
---
$id: http://devicetree.org/schemas/display/panel/synaptics,td4328.yaml#
$schema: http://devicetree.org/meta-schemas/core.yaml#

title: Synaptics TD4328-based DSI display panels

maintainers:
  - Xilin Wu <wuxilin123@gmail.com>

description:
  The Synaptics TD4328 is a generic DSI Panel IC used to control
  LCD panels.

allOf:
  - $ref: panel-common.yaml#

properties:
  compatible:
    contains:
      const: syna,td4328

  vdd-supply:
    description: Digital voltage rail

  vddio-supply:
    description: Digital I/O voltage rail

  reg: true
  port: true

required:
  - compatible
  - reg
  - reset-gpios
  - vdd-supply
  - vddio-supply
  - port

unevaluatedProperties: false

examples:
  - |
    #include <dt-bindings/gpio/gpio.h>

    dsi {
        #address-cells = <1>;
        #size-cells = <0>;

        panel@0 {
            compatible = "syna,td4328";
            reg = <0>;

            backlight = <&backlight>;
            reset-gpios = <&tlmm 133 GPIO_ACTIVE_LOW>;

            vdd-supply = <&vdd_lcm_2p8>;
            vddio-supply = <&vreg_l12b_1p8>;

            port {
                panel_in_0: endpoint {
                    remote-endpoint = <&dsi0_out>;
                };
            };
        };
    };

...
```

## Documentation/devicetree/bindings/media/qcom,sm8550-iris.yaml
```yaml
# SPDX-License-Identifier: (GPL-2.0 OR BSD-2-Clause)
%YAML 1.2
---
$id: http://devicetree.org/schemas/media/qcom,sm8550-iris.yaml#
$schema: http://devicetree.org/meta-schemas/core.yaml#

title: Qualcomm SM8550 IRIS video encode and decode accelerators

maintainers:
  - Vikash Garodia <quic_vgarodia@quicinc.com>
  - Dikshita Agarwal <quic_dikshita@quicinc.com>

description: |
  The Iris IP is a video encode and decode accelerator present
  on Qualcomm platforms.

properties:
  compatible:
    const: qcom,sm8550-vidc

  "address-cells":
    const: 1

  "size-cells":
    const: 1

  reg:
    maxItems: 2

  interrupts:
    maxItems: 1

  power-domains:
    minItems: 2
    maxItems: 4

  power-domain-names:
    items:
      - const: iris-ctl
      - const: vcodec
      - const: mx
      - const: mmcx

  operating-points-v2: true

  clocks:
    maxItems: 3

  clock-names:
    items:
      - const: gcc_video_axi0
      - const: core_clk
      - const: vcodec_clk

  interconnects:
    maxItems: 2

  interconnect-names:
    items:
      - const: venus-cnoc
      - const: venus-ddr

  memory-region:
    maxItems: 1

  resets:
    maxItems: 1

  reset-names:
    items:
      - const: video_axi_reset

  non-secure-cb:
    type: object

    description: |
      This non secure context bank is used for managing
      buffers for encoder and decoder. This subnode is
      needed for a separate probe for this context bank device.

    properties:
      compatible:
        const: "qcom,vidc,cb-ns"

      iommus:
        maxItems: 2

      dma-coherent: true

    required:
      - compatible
      - iommus

    additionalProperties: false

  opp-table:
    type: object

required:
  - compatible
  - reg
  - interrupts
  - power-domains
  - power-domain-names
  - clocks
  - clock-names
  - interconnects
  - interconnect-names
  - memory-region
  - resets
  - reset-names
  - non-secure-cb
  - opp-table

additionalProperties: false

examples:
  - |
    #include <dt-bindings/clock/qcom,rpmh.h>
    #include <dt-bindings/clock/qcom,sm8550-gcc.h>
    #include <dt-bindings/clock/qcom,sm8550-videocc.h>
    #include <dt-bindings/interrupt-controller/arm-gic.h>
    #include <dt-bindings/interconnect/qcom,sm8550-rpmh.h>
    #include <dt-bindings/power/qcom-rpmpd.h>

    venus: video-codec@aa00000 {
        compatible = "qcom,sm8550-vidc";
        status = "okay";

        address-cells = <1>;
        size-cells = <1>;

        reg = <0 0x0aa00000 0 0xF0000>;
        interrupts = <GIC_SPI 174 IRQ_TYPE_LEVEL_HIGH>;

        power-domains = <&videocc VIDEO_CC_MVS0C_GDSC>,
                        <&videocc VIDEO_CC_MVS0_GDSC>,
                        <&rpmhpd SM8550_MXC>,
                        <&rpmhpd SM8550_MMCX>;
        power-domain-names = "iris-ctl", "vcodec", "mx", "mmcx";
        operating-points-v2 = <&venus_opp_table>;

        clocks = <&gcc GCC_VIDEO_AXI0_CLK>,
                 <&videocc VIDEO_CC_MVS0C_CLK>,
                 <&videocc VIDEO_CC_MVS0_CLK>;
        clock-names = "gcc_video_axi0", "core_clk", "vcodec_clk";

        interconnects = <&gem_noc MASTER_APPSS_PROC 0 &config_noc SLAVE_VENUS_CFG 0>,
                        <&mmss_noc MASTER_VIDEO 0 &mc_virt SLAVE_EBI1 0>;
        interconnect-names = "venus-cnoc", "venus-ddr";

        /* FW load region */
        memory-region = <&video_mem>;

        resets = <&gcc GCC_VIDEO_AXI0_CLK_ARES>;
        reset-names = "video_axi_reset";

        non-secure-cb {
            compatible = "qcom,vidc,cb-ns";
            iommus = <&apps_smmu 0x1947 0x0000>,
                     <&apps_smmu 0x1940 0x0000>;
            dma-coherent;
        };

        venus_opp_table: opp-table {
            compatible = "operating-points-v2";

            opp-240000000 {
                opp-hz = /bits/ 64 <240000000>;
                required-opps = <&rpmhpd_opp_svs>,
                                <&rpmhpd_opp_low_svs>;
           };

           opp-338000000 {
               opp-hz = /bits/ 64 <338000000>;
               required-opps = <&rpmhpd_opp_svs>,
                               <&rpmhpd_opp_svs>;
           };

           opp-366000000 {
               opp-hz = /bits/ 64 <366000000>;
               required-opps = <&rpmhpd_opp_svs_l1>,
                               <&rpmhpd_opp_svs_l1>;
           };

           opp-444000000 {
               opp-hz = /bits/ 64 <444000000>;
               required-opps = <&rpmhpd_opp_turbo>,
                               <&rpmhpd_opp_turbo>;
           };

           opp-481000000 {
               opp-hz = /bits/ 64 <481000000>;
               required-opps = <&rpmhpd_opp_turbo_l1>,
                               <&rpmhpd_opp_turbo_l1>;
           };
       };
    };
...
```

## Documentation/devicetree/bindings/mfd/qcom,tcsr.yaml
```yaml
# SPDX-License-Identifier: GPL-2.0-only OR BSD-2-Clause
%YAML 1.2
---
$id: http://devicetree.org/schemas/mfd/qcom,tcsr.yaml#
$schema: http://devicetree.org/meta-schemas/core.yaml#

title: Qualcomm Top Control and Status Register

maintainers:
  - Bjorn Andersson <bjorn.andersson@linaro.org>

description:
  Qualcomm devices have a set of registers that provide various control and
  status functions for their peripherals.

properties:
  compatible:
    oneOf:
      - items:
          - enum:
              - qcom,msm8976-tcsr
              - qcom,msm8998-tcsr
              - qcom,qcs404-tcsr
              - qcom,sc7180-tcsr
              - qcom,sc7280-tcsr
              - qcom,sc8280xp-tcsr
              - qcom,sdm630-tcsr
              - qcom,sdm845-tcsr
              - qcom,sdx55-tcsr
              - qcom,sdx65-tcsr
              - qcom,sm4450-tcsr
              - qcom,sm8150-tcsr
              - qcom,sm8450-tcsr
              - qcom,tcsr-apq8064
              - qcom,tcsr-apq8084
              - qcom,tcsr-ipq8064
              - qcom,tcsr-ipq8074
              - qcom,tcsr-mdm9615
              - qcom,tcsr-msm8226
              - qcom,tcsr-msm8660
              - qcom,tcsr-msm8916
              - qcom,tcsr-msm8953
              - qcom,tcsr-msm8960
              - qcom,tcsr-msm8974
              - qcom,tcsr-msm8996
          - const: syscon
      - items:
          - enum:
              - qcom,tcsr-ipq5332
              - qcom,tcsr-ipq6018
              - qcom,tcsr-ipq9574
          - const: syscon
          - const: simple-mfd

  reg:
    maxItems: 1

  ranges: true

  "#address-cells":
    const: 1

  "#size-cells":
    const: 1

patternProperties:
  "pwm@[a-f0-9]+$":
    type: object
    $ref: /schemas/pwm/qcom,ipq6018-pwm.yaml

required:
  - compatible
  - reg

allOf:
  - if:
      not:
        properties:
          compatible:
            contains:
              enum:
                - qcom,tcsr-ipq5332
                - qcom,tcsr-ipq6018
                - qcom,tcsr-ipq9574
    then:
      patternProperties:
        "pwm@[a-f0-9]+$": false

additionalProperties: false

examples:
  # Example 1 - Syscon node found on MSM8960
  - |
    syscon@1a400000 {
        compatible = "qcom,tcsr-msm8960", "syscon";
        reg = <0x1a400000 0x100>;
    };
  # Example 2 - Syscon node found on IPQ6018
  - |
    #include <dt-bindings/clock/qcom,gcc-ipq6018.h>

    syscon@1937000 {
        compatible = "qcom,tcsr-ipq6018", "syscon", "simple-mfd";
        reg = <0x01937000 0x21000>;
        ranges = <0 0x1937000 0x21000>;
        #address-cells = <1>;
        #size-cells = <1>;

        pwm: pwm@a010 {
            compatible = "qcom,ipq6018-pwm";
            reg = <0xa010 0x20>;
            clocks = <&gcc GCC_ADSS_PWM_CLK>;
            assigned-clocks = <&gcc GCC_ADSS_PWM_CLK>;
            assigned-clock-rates = <100000000>;
            #pwm-cells = <2>;
        };
    };
```

## Documentation/devicetree/bindings/net/wireless/qcom,ath12k-pci.yaml
```yaml
# SPDX-License-Identifier: (GPL-2.0-only OR BSD-2-Clause)
# Copyright (c) 2024 Linaro Limited
%YAML 1.2
---
$id: http://devicetree.org/schemas/net/wireless/qcom,ath12k-pci.yaml#
$schema: http://devicetree.org/meta-schemas/core.yaml#

title: Qualcomm Technologies ath12k wireless devices (PCIe)

maintainers:
  - Bartosz Golaszewski <bartosz.golaszewski@linaro.org>

description: |
  Qualcomm Technologies IEEE 802.11ax PCIe devices

properties:
  compatible:
    enum:
      - pci17cb,1107  # WCN7850

  reg:
    maxItems: 1

  enable-gpios:
    maxItems: 1
    description: GPIO line enabling the WLAN module

  vdd-supply:
    description: VDD supply regulator handle

  vddio-supply:
    description: VDD_IO supply regulator handle

  vddio1p2-supply:
    description: VDD_IO_1P2 supply regulator handle

  vddaon-supply:
    description: VDD_AON supply regulator handle

  vdddig-supply:
    description: VDD_DIG supply regulator handle

  vddrfa1p2-supply:
    description: VDD_RFA_1P2 supply regulator handle

  vddrfa1p8-supply:
    description: VDD_PCIE_1P8 supply regulator handle

  clocks:
    maxItems: 1
    description:
      Reference clock phandle

required:
  - compatible
  - reg
  - vdd-supply
  - vddio-supply
  - vddaon-supply
  - vdddig-supply
  - vddrfa1p2-supply
  - vddrfa1p8-supply

additionalProperties: false

examples:
  - |
    #include <dt-bindings/clock/qcom,rpmh.h>
    #include <dt-bindings/gpio/gpio.h>
    pcie {
        #address-cells = <3>;
        #size-cells = <2>;

        pcie@0 {
            device_type = "pci";
            reg = <0x0 0x0 0x0 0x0 0x0>;
            #address-cells = <3>;
            #size-cells = <2>;
            ranges;

            bus-range = <0x01 0xff>;

            wifi@0 {
                compatible = "pci17cb,1107";
                reg = <0x10000 0x0 0x0 0x0 0x0>;

                pinctrl-names = "default";
                pinctrl-0 = <&wlan_en>;

                enable-gpios = <&tlmm 16 GPIO_ACTIVE_HIGH>;

                vdd-supply = <&vreg_s4i_0p85>;
                vddio-supply = <&vreg_l15b_1p8>;
                vddio1p2-supply = <&vreg_l3c_1p2>;
                vddaon-supply = <&vreg_s2c_0p8>;
                vdddig-supply = <&vreg_s3c_0p9>;
                vddrfa1p2-supply = <&vreg_s1c_1p2>;
                vddrfa1p8-supply = <&vreg_s6c_1p8>;

                clocks = <&rpmhcc RPMH_RF_CLK1>;
            };
        };
    };
```

## Documentation/devicetree/bindings/pwm/si-en,sn3112-pwm.yaml
```yaml
# SPDX-License-Identifier: (GPL-2.0-only OR BSD-2-Clause)
%YAML 1.2
---
$id: http://devicetree.org/schemas/pwm/si-en,sn3112-pwm.yaml#
$schema: http://devicetree.org/meta-schemas/core.yaml#

title: SI-EN SN3112 12-channel 8-bit PWM LED controller

maintainers:
  - Junhao Xie <bigfoot@classfun.cn>

allOf:
  - $ref: pwm.yaml#

properties:
  compatible:
    const: si-en,sn3112-pwm

  reg:
    const: 0x54
    description: I2C slave address

  sdb-gpios:
    maxItems: 1
    description: GPIO pin to hardware shutdown the device.

  vdd-supply:
    description: Chip vdd supply

  "#pwm-cells":
    const: 1

required:
  - compatible
  - reg
  - "#pwm-cells"

additionalProperties: false

examples:
  - |
    #include <dt-bindings/gpio/gpio.h>

    i2c {
      #address-cells = <1>;
      #size-cells = <0>;

      pwm@54 {
        compatible = "si-en,sn3112-pwm";
        reg = <0x54>;
        sdb-gpios = <&pio 1 1 GPIO_ACTIVE_LOW>; /* PA1 */
        vdd-supply = <&reg_dcdc1>;
        #pwm-cells = <1>;
      };
    };
```
